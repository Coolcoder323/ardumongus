#include <Arduboy2.h>
#include <ArduboyTones.h>

Arduboy2 arduboy;
Arduboy2Audio audio;
ArduboyTones sound(audio.enabled);

// Placeholders for your map bitmap data
// Your existing bitmaps:
const unsigned char PROGMEM cafitiria[] =
{
// width, height,
128, 64,
0xff, 0xff, 0xff, 0xff, 0xff, 0xff, 0xff, 0xff, 0xff, 0xff, 0xff, 0xff,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 0xff, 
0xff, 0x7f, 0x7f, 0x7f, 0x3f, 0x3f, 0x3f, 0x3f, 0x1f, 0x1f, 0x1f, 0x1f,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 0xff, 
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0xff, 0xff, 0xff, 0xff, 0xff, 0xff, 0xff, 0xff, 0xff, 0xff, 0xff, 0xff,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 0xff, 
};
const unsigned char PROGMEM electrical[] =
{
// width, height,
128, 64,
0xff, 0xff, 0xff, 0xff, 0xff, 0xff, 0xff, 0xff, 0xff, 0xff, 0xff, 0xff,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 0xff, 
0xff, 0x7f, 0x7f, 0x7f, 0x3f, 0x3f, 0x3f, 0x3f, 0x1f, 0x1f, 0x1f, 0x1f,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 0xff, 
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0xff, 0xff, 0xff, 0xff, 0xff, 0xff, 0xff, 0xff, 0xff, 0xff, 0xff, 0xff,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 0xff, 
};
const unsigned char PROGMEM storage[] =
{
// width, height,
128, 64,
0xff, 0xff, 0xff, 0xff, 0xff, 0xff, 0xff, 0xff, 0xff, 0xff, 0xff, 0xff,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 0xff, 
0xff, 0x7f, 0x7f, 0x7f, 0x3f, 0x3f, 0x3f, 0x3f, 0x1f, 0x1f, 0x1f, 0x1f,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 0xff, 
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0xff, 0xff, 0xff, 0xff, 0xff, 0xff, 0xff, 0xff, 0xff, 0xff, 0xff, 0xff,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 0xff, 
};

const unsigned char PROGMEM reactor[] =
{
// width, height,
128, 64,
0xff, 0xff, 0xff, 0xff, 0xff, 0xff, 0xff, 0xff, 0xff, 0xff, 0xff, 0xff,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 0xff, 
0x07, 0x03, 0x07, 0x1f, 0x3f, 0x3f, 0x3f, 0x3f, 0x1f, 0x1f, 0x1f, 0x1f,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 0xff, 
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0xff, 0xff, 0xff, 0xff, 0xff, 0xff, 0xff, 0xff, 0xff, 0xff, 0xff, 0xff,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 0xff, 
};
const unsigned char PROGMEM lowerengine[] =
{
// width, height,
128, 64,
0xff, 0xff, 0xff, 0xff, 0xff, 0xff, 0xff, 0xff, 0xff, 0xff, 0xff, 0xff,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 0xff, 
0xff, 0x7f, 0x7f, 0x7f, 0x3f, 0x3f, 0x3f, 0x3f, 0x1f, 0x1f, 0x1f, 0x1f,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 0xff, 
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0xff, 0xff, 0xff, 0xff, 0xff, 0xff, 0xff, 0xff, 0xff, 0xff, 0xff, 0xff,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 0xff, 
};
const unsigned char PROGMEM upperengine[] =
{
// width, height,
128, 64,
0xff, 0xff, 0xff, 0xff, 0xff, 0xff, 0xff, 0xff, 0xff, 0xff, 0xff, 0xff,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 0xff, 
0xff, 0x7f, 0x7f, 0x7f, 0x3f, 0x3f, 0x3f, 0x3f, 0x1f, 0x1f, 0x1f, 0x1f,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 0xff, 
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0xff, 0xff, 0xff, 0xff, 0xff, 0xff, 0xff, 0xff, 0xff, 0xff, 0xff, 0xff,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 0xff, 
};
const unsigned char PROGMEM o2[] =
{
// width, height,
128, 64,
0xff, 0xff, 0xff, 0xff, 0xff, 0xff, 0xff, 0xff, 0xff, 0xff, 0xff, 0xff,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 0xff, 
0xff, 0x7f, 0x7f, 0x7f, 0x3f, 0x3f, 0x3f, 0x3f, 0x1f, 0x1f, 0x1f, 0x1f,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 0xff, 
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0xff, 0xff, 0xff, 0xff, 0xff, 0xff, 0xff, 0xff, 0xff, 0xff, 0xff, 0xff,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 0xff, 
};
const unsigned char PROGMEM weapons[] =
{
// width, height,
128, 64,
0xff, 0xff, 0xff, 0xff, 0xff, 0xff, 0xff, 0xff, 0xff, 0xff, 0xff, 0xff,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 0xff, 
0xff, 0x7f, 0x7f, 0x7f, 0x3f, 0x3f, 0x3f, 0x3f, 0x1f, 0x1f, 0x1f, 0x1f,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 0xff, 
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0xff, 0xff, 0xff, 0xff, 0xff, 0xff, 0xff, 0xff, 0xff, 0xff, 0xff, 0xff,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 0xff, 
};
const unsigned char PROGMEM medbay[] =
{
// width, height,
128, 64,
0xff, 0xff, 0xff, 0xff, 0xff, 0xff, 0xff, 0xff, 0xff, 0xff, 0xff, 0xff,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 0xff, 
0xff, 0x7f, 0x7f, 0x7f, 0x3f, 0x3f, 0x3f, 0x3f, 0x1f, 0x1f, 0x1f, 0x1f,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 0xff, 
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0xff, 0xff, 0xff, 0xff, 0xff, 0xff, 0xff, 0xff, 0xff, 0xff, 0xff, 0xff,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 0xff, 
};

// --------------------------------------------------
// SOUND EFFECT TONES
// --------------------------------------------------
const uint16_t soundKill[] PROGMEM = {
  NOTE_C4, 100, NOTE_G3, 100, NOTE_C3, 200, TONES_END
};

const uint16_t soundVent[] PROGMEM = {
  NOTE_E3, 80, NOTE_G3, 80, NOTE_C4, 120, TONES_END
};

const uint16_t soundSabotage[] PROGMEM = {
  NOTE_A4, 100, NOTE_F4, 100, NOTE_C4, 150, TONES_END
};

const uint16_t soundMeeting[] PROGMEM = {
  NOTE_C5, 100, NOTE_E5, 100, NOTE_G5, 100, NOTE_C6, 300, TONES_END
};

const uint16_t soundWin[] PROGMEM = {
  NOTE_C5, 100, NOTE_E5, 100, NOTE_G5, 100, NOTE_C6, 400, TONES_END
};

const uint16_t soundLose[] PROGMEM = {
  NOTE_C4, 150, NOTE_G3, 150, NOTE_E3, 200, NOTE_C3, 400, TONES_END
};

// --------------------------------------------------
// SPRITE BITMAPS (8x8 pixels)
// --------------------------------------------------
const unsigned char PROGMEM playerSprite[] = {
  0x3c, 0x42, 0x9d, 0xb1, 0xb1, 0x9d, 0x42, 0x3c
};

const unsigned char PROGMEM crewmateSprite[] = {
  0x3c, 0x42, 0x81, 0xbd, 0xbd, 0x81, 0x42, 0x3c
};

#define ROOM_W 128
#define ROOM_H 64

#define MAP_ROWS 3
#define MAP_COLS 3

#define NUM_CREWMATES 5
#define NUM_VENTS 6

#define VENT_COOLDOWN_FRAMES 90
#define MELTDOWN_START_FRAMES 600
#define MELTDOWN_COOLDOWN_FRAMES 1800 // 60 seconds at 30 FPS
#define DOOR_SABOTAGE_FRAMES 300      // 10 seconds at 30 FPS

// Game States
enum GameState {
  STATE_MENU,
  STATE_INTRO,
  STATE_INSTRUCTIONS,
  STATE_SETTINGS,
  STATE_PLAYING
};

GameState currentState = STATE_MENU;

// Menu Variables
int menuSelection = 0;
int settingsSelection = 0;

// Settings Options (Sound OFF by default)
bool soundEnabled = false;
int killCooldownOption = 1; // 0 = 5s (150f), 1 = 10s (300f), 2 = 15s (450f)
int killCooldownMaxFrames = 300;

// --------------------------------------------------
// WORLD MAP
// --------------------------------------------------
const unsigned char* worldMap[MAP_ROWS][MAP_COLS] = {
  { upperengine, electrical, weapons },
  { reactor,     cafitiria,  o2      },
  { lowerengine, storage,    medbay  }
};

// --------------------------------------------------
// CREWMATES
// --------------------------------------------------
struct Crewmate {
  int x, y;
  bool alive;
  int roomRow, roomCol;
  int targetRow, targetCol;

  int suspicion;   
  int tolerance;   

  bool gotBodySuspicion; 
};

Crewmate crewmates[NUM_CREWMATES];

// --------------------------------------------------
// VENTS
// --------------------------------------------------
struct Vent {
  int row, col;
  int x, y;
  int linkA;
};

Vent vents[NUM_VENTS] = {
  {0, 0, 10, 10, 1},
  {0, 1, 100, 10, 0},

  {1, 0, 10, 50, 3},
  {1, 2, 100, 50, 2},

  {2, 0, 10, 10, 5},
  {2, 2, 100, 10, 4}
};

// --------------------------------------------------
// PLAYER & GAME STATE
// --------------------------------------------------
int playerX = 40;
int playerY = 30;

int roomRow = 1;
int roomCol = 1;

int playerSuspicion = 0;

bool inVent = false;
bool meetingCalled = false;
int meetingTimer = 0; 
int meetingResultTimer = 0;
int ejectedID = -1;

bool sabotageDoors = false;
int doorTimer = 0;

bool reactorMeltdown = false;
bool impostorWin = false;
bool crewmatesWin = false;
bool playerEjected = false;

int meltdownTimer = MELTDOWN_START_FRAMES;
int meltdownCooldown = 0;
int ventCooldown = 0;
int killCooldown = 300;

// Helper function to play sound safely
void playTone(const uint16_t *tones) {
  if (soundEnabled) {
    sound.tones(tones);
  }
}

// --------------------------------------------------
// HELPERS
// --------------------------------------------------
bool near(int x1, int y1, int x2, int y2, int d = 12) {
  return (abs(x1 - x2) <= d && abs(y1 - y2) <= d);
}

int findNearestVent(int row, int col, int px, int py) {
  int best = -1;
  int bestDist = 9999;

  for (int i = 0; i < NUM_VENTS; i++) {
    if (vents[i].row == row && vents[i].col == col) {
      int dx = px - vents[i].x;
      int dy = py - vents[i].y;
      int dist = abs(dx) + abs(dy);
      if (dist < bestDist) {
        bestDist = dist;
        best = i;
      }
    }
  }
  return best;
}

// --------------------------------------------------
// GAME RESET
// --------------------------------------------------
void initGame() {
  playerX = 40;
  playerY = 30;
  roomRow = 1;
  roomCol = 1;
  playerSuspicion = 0;

  inVent = false;
  meetingCalled = false;
  meetingTimer = 0;
  meetingResultTimer = 0;
  ejectedID = -1;

  sabotageDoors = false;
  doorTimer = 0;
  reactorMeltdown = false;
  impostorWin = false;
  crewmatesWin = false;
  playerEjected = false;

  meltdownTimer = MELTDOWN_START_FRAMES;
  meltdownCooldown = 0;
  ventCooldown = 0;

  // Set kill cooldown based on settings
  if (killCooldownOption == 0) killCooldownMaxFrames = 150;      // 5s
  else if (killCooldownOption == 1) killCooldownMaxFrames = 300; // 10s
  else if (killCooldownOption == 2) killCooldownMaxFrames = 450; // 15s

  killCooldown = killCooldownMaxFrames;

  for (int i = 0; i < NUM_CREWMATES; i++) {
    crewmates[i].x = random(10, ROOM_W - 10);
    crewmates[i].y = random(10, ROOM_H - 10);
    crewmates[i].alive = true;
    crewmates[i].roomRow = 1;
    crewmates[i].roomCol = 1;
    crewmates[i].targetRow = random(0, MAP_ROWS);
    crewmates[i].targetCol = random(0, MAP_COLS);
    crewmates[i].suspicion = 0;
    crewmates[i].tolerance = random(20, 80);
    crewmates[i].gotBodySuspicion = false;
  }
}

// --------------------------------------------------
// MENU & GUI SYSTEM
// --------------------------------------------------
void handleMenuInput() {
  if (arduboy.justPressed(UP_BUTTON)) {
    menuSelection--;
    if (menuSelection < 0) menuSelection = 2;
  }
  if (arduboy.justPressed(DOWN_BUTTON)) {
    menuSelection++;
    if (menuSelection > 2) menuSelection = 0;
  }

  if (arduboy.justPressed(A_BUTTON)) {
    if (menuSelection == 0) {
      initGame();
      currentState = STATE_INTRO;
    } else if (menuSelection == 1) {
      currentState = STATE_INSTRUCTIONS;
    } else if (menuSelection == 2) {
      currentState = STATE_SETTINGS;
    }
  }
}

void drawMenu() {
  arduboy.setCursor(2, 5);
  arduboy.print(F("OPERATION:INVASION HALT"));

  arduboy.setCursor(20, 24);
  arduboy.print(menuSelection == 0 ? F("> START GAME") : F("  START GAME"));

  arduboy.setCursor(20, 36);
  arduboy.print(menuSelection == 1 ? F("> INSTRUCTIONS") : F("  INSTRUCTIONS"));

  arduboy.setCursor(20, 48);
  arduboy.print(menuSelection == 2 ? F("> SETTINGS") : F("  SETTINGS"));
}

void drawIntroScreen() {
  arduboy.setCursor(28, 2);
  arduboy.print(F("MISSION BRIEF"));

  arduboy.setCursor(0, 14);
  arduboy.print(F("You have invaded an"));
  arduboy.setCursor(0, 23);
  arduboy.print(F("alien ship, disguised"));
  arduboy.setCursor(0, 32);
  arduboy.print(F("as one of them. They"));
  arduboy.setCursor(0, 41);
  arduboy.print(F("are headed for Earth!"));

  arduboy.setCursor(0, 54);
  arduboy.print(F("Eliminate all aliens!"));

  if (arduboy.justPressed(A_BUTTON)) {
    currentState = STATE_PLAYING;
  }
}

void drawInstructions() {
  arduboy.setCursor(25, 2);
  arduboy.print(F("- INSTRUCTIONS -"));

  arduboy.setCursor(0, 14);
  arduboy.print(F("D-Pad: Move Around"));
  arduboy.setCursor(0, 24);
  arduboy.print(F("B: Eliminate Alien"));
  arduboy.setCursor(0, 34);
  arduboy.print(F("A: Enter/Exit Vent"));
  arduboy.setCursor(0, 44);
  arduboy.print(F("UP+A: Sabotage"));
  arduboy.setCursor(0, 54);
  arduboy.print(F("DN+B: Report/Call"));

  if (arduboy.justPressed(B_BUTTON) || arduboy.justPressed(A_BUTTON)) {
    currentState = STATE_MENU;
  }
}

void handleSettingsInput() {
  if (arduboy.justPressed(UP_BUTTON)) {
    settingsSelection--;
    if (settingsSelection < 0) settingsSelection = 1;
  }
  if (arduboy.justPressed(DOWN_BUTTON)) {
    settingsSelection++;
    if (settingsSelection > 1) settingsSelection = 0;
  }

  if (settingsSelection == 0 && (arduboy.justPressed(LEFT_BUTTON) || arduboy.justPressed(RIGHT_BUTTON) || arduboy.justPressed(A_BUTTON))) {
    soundEnabled = !soundEnabled;
  }

  if (settingsSelection == 1) {
    if (arduboy.justPressed(RIGHT_BUTTON) || arduboy.justPressed(A_BUTTON)) {
      killCooldownOption = (killCooldownOption + 1) % 3;
    }
    if (arduboy.justPressed(LEFT_BUTTON)) {
      killCooldownOption--;
      if (killCooldownOption < 0) killCooldownOption = 2;
    }
  }

  if (arduboy.justPressed(B_BUTTON)) {
    currentState = STATE_MENU;
  }
}

void drawSettings() {
  arduboy.setCursor(30, 5);
  arduboy.print(F("- SETTINGS -"));

  arduboy.setCursor(10, 25);
  arduboy.print(settingsSelection == 0 ? F("> SOUND: ") : F("  SOUND: "));
  arduboy.print(soundEnabled ? F("ON") : F("OFF"));

  arduboy.setCursor(10, 40);
  arduboy.print(settingsSelection == 1 ? F("> KILL CD: ") : F("  KILL CD: "));
  if (killCooldownOption == 0) arduboy.print(F("5s"));
  else if (killCooldownOption == 1) arduboy.print(F("10s"));
  else if (killCooldownOption == 2) arduboy.print(F("15s"));

  arduboy.setCursor(15, 56);
  arduboy.print(F("Press B to return"));
}

// --------------------------------------------------
// CREWMATE BODY REPORTS + SUSPICION
// --------------------------------------------------
void checkBodyReports() {
  if (meetingCalled || impostorWin || crewmatesWin || playerEjected) return;

  for (int i = 0; i < NUM_CREWMATES; i++) {
    if (!crewmates[i].alive) continue;

    for (int j = 0; j < NUM_CREWMATES; j++) {
      if (i == j) continue;

      if (!crewmates[j].alive &&
          crewmates[j].roomRow == crewmates[i].roomRow &&
          crewmates[j].roomCol == crewmates[i].roomCol &&
          near(crewmates[i].x, crewmates[i].y, crewmates[j].x, crewmates[j].y, 20)) {

        meetingCalled = true;
        meetingTimer = 60;
        meetingResultTimer = 0;
        ejectedID = -1;
        playTone(soundMeeting);
        return;
      }
    }
  }
}

// --------------------------------------------------
// CREWMATE UPDATE
// --------------------------------------------------
void updateCrewmates() {
  if (meetingCalled || impostorWin || crewmatesWin || playerEjected) return;

  int aliveCount = 0;

  for (int i = 0; i < NUM_CREWMATES; i++) {
    if (!crewmates[i].alive) continue;
    aliveCount++;

    Crewmate &c = crewmates[i];

    if (inVent && c.roomRow == roomRow && c.roomCol == roomCol) {
      if (near(playerX, playerY, c.x, c.y, 30)) {
        playerSuspicion += 1;
      }
    }

    bool bodyInRoom = false;
    for (int j = 0; j < NUM_CREWMATES; j++) {
      if (!crewmates[j].alive &&
          crewmates[j].roomRow == c.roomRow &&
          crewmates[j].roomCol == c.roomCol) {
        bodyInRoom = true;
      }
    }
    if (bodyInRoom && !c.gotBodySuspicion) {
      c.suspicion += 10;
      c.gotBodySuspicion = true;
    }
    if (!bodyInRoom) {
      c.gotBodySuspicion = false;
    }

    if (c.roomRow == c.targetRow && c.roomCol == c.targetCol) {
      c.targetRow = random(0, MAP_ROWS);
      c.targetCol = random(0, MAP_COLS);
    }

    int speed = 1;

    if (c.roomRow != c.targetRow || c.roomCol != c.targetCol) {
      int doorX = ROOM_W / 2;
      int doorY = ROOM_H / 2;

      if (c.targetRow < c.roomRow) {
        doorY = 0;
        if (c.y > doorY) c.y -= speed;
        if (abs(c.y - doorY) <= 1 && !sabotageDoors) {
          c.roomRow--;
          c.y = ROOM_H - 10;
        }
      } else if (c.targetRow > c.roomRow) {
        doorY = ROOM_H - 8;
        if (c.y < doorY) c.y += speed;
        if (abs(c.y - doorY) <= 1 && !sabotageDoors) {
          c.roomRow++;
          c.y = 2;
        }
      } else if (c.targetCol < c.roomCol) {
        doorX = 0;
        if (c.x > doorX) c.x -= speed;
        if (abs(c.x - doorX) <= 1 && !sabotageDoors) {
          c.roomCol--;
          c.x = ROOM_W - 10;
        }
      } else if (c.targetCol > c.roomCol) {
        doorX = ROOM_W - 8;
        if (c.x < doorX) c.x += speed;
        if (abs(c.x - doorX) <= 1 && !sabotageDoors) {
          c.roomCol++;
          c.x = 2;
        }
      }
    }
  }

  if (aliveCount == 0 && !impostorWin) {
    impostorWin = true;
    playTone(soundWin);
  }
}

// --------------------------------------------------
// CREWMATES FIX MELTDOWN
// --------------------------------------------------
void crewmatesFixMeltdown() {
  if (!reactorMeltdown) return;

  for (int i = 0; i < NUM_CREWMATES; i++) {
    if (!crewmates[i].alive) continue;

    if (crewmates[i].roomRow == 1 && crewmates[i].roomCol == 0) {
      if (random(0, 100) < 90) {
        reactorMeltdown = false;
        meltdownTimer = MELTDOWN_START_FRAMES;
        meltdownCooldown = MELTDOWN_COOLDOWN_FRAMES; // Start 60s cooldown
        return;
      }
    }
  }
}

// --------------------------------------------------
// MOVEMENT
// --------------------------------------------------
void handleMovement() {
  if (meetingCalled || impostorWin || crewmatesWin || playerEjected) return;

  if (!inVent) {
    int speed = 1;

    if (arduboy.pressed(LEFT_BUTTON))  playerX -= speed;
    if (arduboy.pressed(RIGHT_BUTTON)) playerX += speed;
    if (arduboy.pressed(UP_BUTTON))    playerY -= speed;
    if (arduboy.pressed(DOWN_BUTTON))  playerY += speed;
  }

  if (playerX < 0) playerX = 0;
  if (playerX > ROOM_W - 8) playerX = ROOM_W - 8;
  if (playerY < 0) playerY = 0;
  if (playerY > ROOM_H - 8) playerY = ROOM_H - 8;

  int doorX1 = ROOM_W/2 - 8;
  int doorX2 = ROOM_W/2 + 8;
  int doorY1 = ROOM_H/2 - 8;
  int doorY2 = ROOM_H/2 + 8;

  if (!sabotageDoors && !inVent) {
    if (playerY <= 0 && playerX >= doorX1 && playerX <= doorX2 && roomRow > 0) {
      roomRow--;
      playerY = ROOM_H - 10;
    }

    if (playerY >= ROOM_H - 8 && playerX >= doorX1 && playerX <= doorX2 && roomRow < MAP_ROWS - 1) {
      roomRow++;
      playerY = 2;
    }

    if (playerX <= 0 && playerY >= doorY1 && playerY <= doorY2 && roomCol > 0) {
      roomCol--;
      playerX = ROOM_W - 10;
    }

    if (playerX >= ROOM_W - 8 && playerY >= doorY1 && playerY <= doorY2 && roomCol < MAP_COLS - 1) {
      roomCol++;
      playerX = 2;
    }
  }
}

// --------------------------------------------------
// ACTIONS
// --------------------------------------------------
void handleActions() { 
    if (impostorWin || crewmatesWin || playerEjected) return; 

    // Emergency meeting (DOWN + B) 
    if (!meetingCalled && arduboy.pressed(DOWN_BUTTON) && arduboy.justPressed(B_BUTTON)) { 
        bool someoneDead = false; 
        for (int i = 0; i < NUM_CREWMATES; i++) {
            if (!crewmates[i].alive) someoneDead = true; 
        }
        if (someoneDead) { 
            meetingCalled = true; 
            meetingTimer = 60;
            meetingResultTimer = 0;
            ejectedID = -1;
            playTone(soundMeeting);
        } 
    } 

    if (meetingCalled) return; 

    // Kill (B) 
    if (!inVent && killCooldown == 0 && arduboy.justPressed(B_BUTTON)) { 
        for (int i = 0; i < NUM_CREWMATES; i++) { 
            if (crewmates[i].alive && crewmates[i].roomRow == roomRow && crewmates[i].roomCol == roomCol && near(playerX, playerY, crewmates[i].x, crewmates[i].y)) { 
                crewmates[i].alive = false; 
                killCooldown = killCooldownMaxFrames;
                playTone(soundKill);
                
                for (int w = 0; w < NUM_CREWMATES; w++) { 
                    if (crewmates[w].alive && crewmates[w].roomRow == roomRow && crewmates[w].roomCol == roomCol) { 
                        playerSuspicion += 25; 
                    } 
                } 
                return; 
            } 
        } 
    } 

    // Vent (A) 
    if (arduboy.justPressed(A_BUTTON) && ventCooldown == 0) { 
        int v = findNearestVent(roomRow, roomCol, playerX, playerY);
        
        if (!inVent) { 
            if (v != -1 && near(playerX, playerY, vents[v].x, vents[v].y)) { 
                inVent = true; 
                playerX = vents[v].x; 
                playerY = vents[v].y; 
                ventCooldown = VENT_COOLDOWN_FRAMES; 
                playTone(soundVent);

                for (int w = 0; w < NUM_CREWMATES; w++) {
                    if (crewmates[w].alive && crewmates[w].roomRow == roomRow && crewmates[w].roomCol == roomCol) {
                        playerSuspicion += 15;
                    }
                }
                return; 
            } 
        } else { 
            if (v != -1) { 
                int destVent = vents[v].linkA; 
                roomRow = vents[destVent].row; 
                roomCol = vents[destVent].col; 
                playerX = vents[destVent].x; 
                playerY = vents[destVent].y; 
                inVent = false; 
                ventCooldown = VENT_COOLDOWN_FRAMES; 
                playTone(soundVent);
                return; 
            } 
        } 
    } 

    // Sabotage Doors/Reactor (UP + A)
    if (!inVent && arduboy.pressed(UP_BUTTON) && arduboy.justPressed(A_BUTTON)) { 
        sabotageDoors = true; 
        doorTimer = DOOR_SABOTAGE_FRAMES; 
        if (!reactorMeltdown && meltdownCooldown == 0) {
            reactorMeltdown = true; 
            meltdownTimer = MELTDOWN_START_FRAMES; 
            playTone(soundSabotage);
        }
    } 
}

// --------------------------------------------------
// TIMERS UPDATE
// --------------------------------------------------
void updateTimers() {
  if (sabotageDoors) {
    if (doorTimer > 0) {
      doorTimer--;
    } else {
      sabotageDoors = false; 
    }
  }

  if (reactorMeltdown && !meetingCalled && !impostorWin && !crewmatesWin && !playerEjected) {
    if (meltdownTimer > 0) {
      meltdownTimer--;
    } else {
      impostorWin = true;
      playTone(soundWin);
    }
  }

  if (meltdownCooldown > 0 && !reactorMeltdown) {
    meltdownCooldown--;
  }
}

// --------------------------------------------------
// MEETING RESOLUTION
// --------------------------------------------------
void resolveMeeting() {
  if (!meetingCalled) return;

  if (meetingTimer > 0) {
    meetingTimer--;
    return;
  }

  if (meetingResultTimer == 0 && ejectedID == -1) {
    int votesOnPlayer = 0;
    int votesOnCrew[NUM_CREWMATES] = {0};

    for (int i = 0; i < NUM_CREWMATES; i++) {
      if (!crewmates[i].alive) continue;

      Crewmate &c = crewmates[i];
      int voteTarget = -1;

      if (playerSuspicion > c.tolerance) {
        voteTarget = -2;
      } else if (c.suspicion > c.tolerance) {
        int aliveCrew[NUM_CREWMATES];
        int count = 0;
        for (int k = 0; k < NUM_CREWMATES; k++) {
          if (crewmates[k].alive && k != i) {
            aliveCrew[count++] = k;
          }
        }
        if (count > 0) {
          voteTarget = aliveCrew[random(0, count)];
        } else {
          voteTarget = -1;
        }
      } else {
        voteTarget = -1;
      }

      if (voteTarget == -2) votesOnPlayer++;
      else if (voteTarget >= 0) votesOnCrew[voteTarget]++;
    }

    int aliveCount = 0;
    for (int i = 0; i < NUM_CREWMATES; i++) {
      if (crewmates[i].alive) aliveCount++;
    }

    int majority = (aliveCount / 2) + 1;

    if (votesOnPlayer >= majority) {
      ejectedID = -2;
    } else {
      int bestCrew = -1;
      int bestVotes = 0;
      for (int i = 0; i < NUM_CREWMATES; i++) {
        if (votesOnCrew[i] > bestVotes) {
          bestVotes = votesOnCrew[i];
          bestCrew = i;
        }
      }

      if (bestCrew != -1 && bestVotes >= majority) {
        ejectedID = bestCrew;
      } else {
        ejectedID = -3;
      }
    }

    meetingResultTimer = 90;
  }

  if (meetingResultTimer > 0) {
    meetingResultTimer--;
    if (meetingResultTimer == 0) {
      for (int i = 0; i < NUM_CREWMATES; i++) {
        if (!crewmates[i].alive) {
          crewmates[i].roomRow = -1;
          crewmates[i].roomCol = -1;
        }
      }

      if (ejectedID == -2) {
        playerEjected = true;
        crewmatesWin = true;
        playTone(soundLose);
      } else if (ejectedID >= 0) {
        crewmates[ejectedID].alive = false;
        crewmates[ejectedID].roomRow = -1;
        crewmates[ejectedID].roomCol = -1;
      }

      killCooldown = killCooldownMaxFrames;
      meetingCalled = false;
    }
  }
}

// --------------------------------------------------
// DRAW ROOM
// --------------------------------------------------
void drawRoom() {
  arduboy.drawBitmap(0, 0, worldMap[roomRow][roomCol], ROOM_W, ROOM_H, WHITE);

  int cx = ROOM_W / 2;
  int cy = ROOM_H / 2;

  arduboy.drawRect(cx - 8, 0,        16, 8, BLACK);
  arduboy.drawRect(cx - 8, ROOM_H-8, 16, 8, BLACK);
  arduboy.drawRect(0,      cy - 8,    8, 16, BLACK);
  arduboy.drawRect(ROOM_W-8, cy - 8,  8, 16, BLACK);

  if (sabotageDoors) {
    arduboy.fillRect(cx - 8, 0,        16, 8, BLACK);
    arduboy.fillRect(cx - 8, ROOM_H-8, 16, 8, BLACK);
    arduboy.fillRect(0,      cy - 8,    8, 16, BLACK);
    arduboy.fillRect(ROOM_W-8, cy - 8,  8, 16, BLACK);
  }
}

// --------------------------------------------------
// DRAW ENTITIES
// --------------------------------------------------
void drawEntities() {

  if (meetingCalled) {
    arduboy.fillRect(0, 0, ROOM_W, ROOM_H, BLACK);

    if (meetingTimer > 0) {
      arduboy.setCursor(10, 20);
      arduboy.print(F("EMERGENCY MEETING"));
      arduboy.setCursor(30, 35);
      arduboy.print(F("Voting..."));
    } else {
      arduboy.setCursor(10, 15);
      arduboy.print(F("VOTE RESULTS:"));

      arduboy.setCursor(10, 35);
      if (ejectedID == -2) {
        arduboy.print(F("YOU WERE EJECTED!"));
      } else if (ejectedID >= 0) {
        arduboy.print(F("ALIEN "));
        arduboy.print(ejectedID + 1);
        arduboy.print(F(" EJECTED"));
      } else {
        arduboy.print(F("NO ONE WAS EJECTED"));
      }
    }
    return;
  }

  // Draw Crewmates
  for (int i = 0; i < NUM_CREWMATES; i++) {
    if (crewmates[i].alive &&
        crewmates[i].roomRow == roomRow &&
        crewmates[i].roomCol == roomCol) {

      arduboy.drawBitmap(crewmates[i].x, crewmates[i].y, crewmateSprite, 8, 8, BLACK);
    }
  }

  // Draw Dead Bodies
  for (int i = 0; i < NUM_CREWMATES; i++) {
    if (!crewmates[i].alive &&
        crewmates[i].roomRow == roomRow &&
        crewmates[i].roomCol == roomCol) {

      int bx = crewmates[i].x;
      int by = crewmates[i].y;
      arduboy.drawLine(bx,   by,   bx+4, by+4, WHITE);
      arduboy.drawLine(bx+4, by,   bx,   by+4, WHITE);
    }
  }

  // Draw Vents
  for (int i = 0; i < NUM_VENTS; i++) {
    if (vents[i].row == roomRow && vents[i].col == roomCol) {

      int vx = vents[i].x;
      int vy = vents[i].y;

      arduboy.fillRect(vx, vy, 14, 14, WHITE);
      arduboy.drawRect(vx, vy, 14, 14, BLACK);

      arduboy.drawLine(vx + 2, vy + 4,  vx + 12, vy + 4,  BLACK);
      arduboy.drawLine(vx + 2, vy + 7,  vx + 12, vy + 7,  BLACK);
      arduboy.drawLine(vx + 2, vy + 10, vx + 12, vy + 10, BLACK);
    }
  }

  // Draw Player
  if (!inVent && !impostorWin && !crewmatesWin && !playerEjected) {
    arduboy.drawBitmap(playerX, playerY, playerSprite, 8, 8, BLACK);
  }

  // Vent Cooldown Bar (Bottom Right)
  if (ventCooldown > 0) {
    int w = map(ventCooldown, 0, VENT_COOLDOWN_FRAMES, 0, 36);
    arduboy.drawRect(88, ROOM_H - 4, 36, 4, WHITE);
    arduboy.fillRect(88, ROOM_H - 4, w, 4, WHITE);
  }

  // Meltdown Sabotage Cooldown Bar (Bottom Center)
  if (meltdownCooldown > 0 && !impostorWin && !crewmatesWin && !playerEjected) {
    int w = map(meltdownCooldown, 0, MELTDOWN_COOLDOWN_FRAMES, 0, 36);
    arduboy.drawRect(45, ROOM_H - 4, 36, 4, WHITE);
    arduboy.fillRect(45, ROOM_H - 4, w, 4, WHITE);
  }

  // Kill Cooldown Bar (Bottom Left)
  if (killCooldown > 0 && !impostorWin && !crewmatesWin && !playerEjected) {
    int w = map(killCooldown, 0, killCooldownMaxFrames, 0, 36);
    arduboy.drawRect(2, ROOM_H - 4, 36, 4, WHITE);
    arduboy.fillRect(2, ROOM_H - 4, w, 4, WHITE);
  }

  if (reactorMeltdown && !impostorWin && !crewmatesWin && !playerEjected) {
    arduboy.setCursor(2, 2);
    arduboy.print(F("REACTOR MELTDOWN"));
    arduboy.setCursor(2, 12);
    arduboy.print(F("TIME: "));
    arduboy.print(meltdownTimer / 30);
  }

  if (impostorWin) {
    arduboy.fillRect(0, 0, ROOM_W, ROOM_H, BLACK);
    arduboy.setCursor(12, 12);
    arduboy.print(F("ALIEN SHIP PURGED!"));
    arduboy.setCursor(20, 26);
    arduboy.print(F("Earth is saved!"));
    arduboy.setCursor(10, 44);
    arduboy.print(F("Press A to menu"));
  }

  if (crewmatesWin) {
    arduboy.fillRect(0, 0, ROOM_W, ROOM_H, BLACK);
    arduboy.setCursor(12, 12);
    arduboy.print(F("YOU WERE EJECTED!"));
    arduboy.setCursor(2, 26);
    arduboy.print(F("Aliens reached Earth..."));
    arduboy.setCursor(10, 44);
    arduboy.print(F("Press A to menu"));
  }
}

// --------------------------------------------------
// SETUP / LOOP
// --------------------------------------------------
void setup() {
  arduboy.begin();
  arduboy.setFrameRate(30);
  randomSeed(analogRead(0));
}

void loop() {
  if (!arduboy.nextFrame()) return;

  arduboy.pollButtons();

  if (currentState == STATE_MENU) {
    handleMenuInput();
    arduboy.clear();
    drawMenu();
    arduboy.display();
  } 
  else if (currentState == STATE_INTRO) {
    arduboy.clear();
    drawIntroScreen();
    arduboy.display();
  }
  else if (currentState == STATE_INSTRUCTIONS) {
    arduboy.clear();
    drawInstructions();
    arduboy.display();
  } 
  else if (currentState == STATE_SETTINGS) {
    handleSettingsInput();
    arduboy.clear();
    drawSettings();
    arduboy.display();
  } 
  else if (currentState == STATE_PLAYING) {
    if ((impostorWin || crewmatesWin || playerEjected) && arduboy.justPressed(A_BUTTON)) {
      currentState = STATE_MENU;
    }

    handleMovement();
    handleActions();
    updateCrewmates();
    checkBodyReports();
    updateTimers();
    crewmatesFixMeltdown();

    if (ventCooldown > 0) ventCooldown--;
    if (killCooldown > 0) killCooldown--;

    if (meetingCalled) {
      resolveMeeting();
    }

    arduboy.clear();
    drawRoom();
    drawEntities();
    arduboy.display();
  }
}
