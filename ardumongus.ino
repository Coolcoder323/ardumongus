#include <Arduboy2.h>
Arduboy2 arduboy;

// --------------------------------------------------
// PLACEHOLDER ROOM BITMAPS (128x64 blank images)
// --------------------------------------------------
// Your existing bitmaps:
const unsigned char PROGMEM cafitiria[] =
{
// width, height,
128, 64,
0xff, 0xff, 0xff, 0xff, 0xff, 0xff, 0xff, 0xff, 0xff, 0xff, 0xff, 0xff,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 0xff, 
0xff, 0x7f, 0x7f, 0x7f, 0x3f, 0x3f, 0x3f, 0x3f, 0x1f, 0x1f, 0x1f, 0x1f,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 0xff, 
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0xff, 0xff, 0xff, 0xff, 0xff, 0xff, 0xff, 0xff, 0xff, 0xff, 0xff, 0xff,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 0xff, 
};
const unsigned char PROGMEM electrical[] =
{
// width, height,
128, 64,
0xff, 0xff, 0xff, 0xff, 0xff, 0xff, 0xff, 0xff, 0xff, 0xff, 0xff, 0xff,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 0xff, 
0xff, 0x7f, 0x7f, 0x7f, 0x3f, 0x3f, 0x3f, 0x3f, 0x1f, 0x1f, 0x1f, 0x1f,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 0xff, 
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0xff, 0xff, 0xff, 0xff, 0xff, 0xff, 0xff, 0xff, 0xff, 0xff, 0xff, 0xff,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 0xff, 
};
const unsigned char PROGMEM storage[] =
{
// width, height,
128, 64,
0xff, 0xff, 0xff, 0xff, 0xff, 0xff, 0xff, 0xff, 0xff, 0xff, 0xff, 0xff,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 0xff, 
0xff, 0x7f, 0x7f, 0x7f, 0x3f, 0x3f, 0x3f, 0x3f, 0x1f, 0x1f, 0x1f, 0x1f,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 0xff, 
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0xff, 0xff, 0xff, 0xff, 0xff, 0xff, 0xff, 0xff, 0xff, 0xff, 0xff, 0xff,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 0xff, 
};

const unsigned char PROGMEM reactor[] =
{
// width, height,
128, 64,
0xff, 0xff, 0xff, 0xff, 0xff, 0xff, 0xff, 0xff, 0xff, 0xff, 0xff, 0xff,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 0xff, 
0x07, 0x03, 0x07, 0x1f, 0x3f, 0x3f, 0x3f, 0x3f, 0x1f, 0x1f, 0x1f, 0x1f,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 0xff, 
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0xff, 0xff, 0xff, 0xff, 0xff, 0xff, 0xff, 0xff, 0xff, 0xff, 0xff, 0xff,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 0xff, 
};
const unsigned char PROGMEM lowerengine[] =
{
// width, height,
128, 64,
0xff, 0xff, 0xff, 0xff, 0xff, 0xff, 0xff, 0xff, 0xff, 0xff, 0xff, 0xff,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 0xff, 
0xff, 0x7f, 0x7f, 0x7f, 0x3f, 0x3f, 0x3f, 0x3f, 0x1f, 0x1f, 0x1f, 0x1f,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 0xff, 
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0xff, 0xff, 0xff, 0xff, 0xff, 0xff, 0xff, 0xff, 0xff, 0xff, 0xff, 0xff,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 0xff, 
};
const unsigned char PROGMEM upperengine[] =
{
// width, height,
128, 64,
0xff, 0xff, 0xff, 0xff, 0xff, 0xff, 0xff, 0xff, 0xff, 0xff, 0xff, 0xff,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 0xff, 
0xff, 0x7f, 0x7f, 0x7f, 0x3f, 0x3f, 0x3f, 0x3f, 0x1f, 0x1f, 0x1f, 0x1f,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 0xff, 
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0xff, 0xff, 0xff, 0xff, 0xff, 0xff, 0xff, 0xff, 0xff, 0xff, 0xff, 0xff,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 0xff, 
};
const unsigned char PROGMEM o2[] =
{
// width, height,
128, 64,
0xff, 0xff, 0xff, 0xff, 0xff, 0xff, 0xff, 0xff, 0xff, 0xff, 0xff, 0xff,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 0xff, 
0xff, 0x7f, 0x7f, 0x7f, 0x3f, 0x3f, 0x3f, 0x3f, 0x1f, 0x1f, 0x1f, 0x1f,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 0xff, 
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0xff, 0xff, 0xff, 0xff, 0xff, 0xff, 0xff, 0xff, 0xff, 0xff, 0xff, 0xff,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 0xff, 
};
const unsigned char PROGMEM weapons[] =
{
// width, height,
128, 64,
0xff, 0xff, 0xff, 0xff, 0xff, 0xff, 0xff, 0xff, 0xff, 0xff, 0xff, 0xff,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 0xff, 
0xff, 0x7f, 0x7f, 0x7f, 0x3f, 0x3f, 0x3f, 0x3f, 0x1f, 0x1f, 0x1f, 0x1f,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 0xff, 
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0xff, 0xff, 0xff, 0xff, 0xff, 0xff, 0xff, 0xff, 0xff, 0xff, 0xff, 0xff,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 0xff, 
};
const unsigned char PROGMEM medbay[] =
{
// width, height,
128, 64,
0xff, 0xff, 0xff, 0xff, 0xff, 0xff, 0xff, 0xff, 0xff, 0xff, 0xff, 0xff,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 0xff, 
0xff, 0x7f, 0x7f, 0x7f, 0x3f, 0x3f, 0x3f, 0x3f, 0x1f, 0x1f, 0x1f, 0x1f,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 0xff, 
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0xff, 0xff, 0xff, 0xff, 0xff, 0xff, 0xff, 0xff, 0xff, 0xff, 0xff, 0xff,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 0xff, 
};
// --------------------------------------------------
// CONSTANTS
// --------------------------------------------------
#define ROOM_W 128
#define ROOM_H 64

#define MAP_ROWS 3
#define MAP_COLS 3

#define NUM_CREWMATES 5
#define NUM_VENTS 6

#define VENT_COOLDOWN_FRAMES 90
#define MELTDOWN_START_FRAMES 600

// --------------------------------------------------
// WORLD MAP
// --------------------------------------------------
const unsigned char* worldMap[MAP_ROWS][MAP_COLS] = {
  { upperengine, electrical, weapons },
  { reactor,     cafitiria,  o2      },
  { lowerengine, storage,    medbay  }
};

// --------------------------------------------------
// CREWMATES
// --------------------------------------------------
struct Crewmate {
  int x, y;
  bool alive;
  int roomRow, roomCol;
  int targetRow, targetCol;

  int suspicion;   // invisible suspicion points
  int tolerance;   // random threshold

  bool gotBodySuspicion; // S‑ONCE flag
};

Crewmate crewmates[NUM_CREWMATES];

// --------------------------------------------------
// VENTS
// --------------------------------------------------
struct Vent {
  int row, col;
  int x, y;
  int linkA;
};

Vent vents[NUM_VENTS] = {
  {0, 0, 10, 10, 1},
  {0, 1, 100, 10, 0},

  {1, 0, 10, 50, 3},
  {1, 2, 100, 50, 2},

  {2, 0, 10, 10, 5},
  {2, 2, 100, 10, 4}
};

// --------------------------------------------------
// PLAYER & GAME STATE
// --------------------------------------------------
int playerX = 40;
int playerY = 30;

int roomRow = 1;
int roomCol = 1;

bool inVent = false;
bool meetingCalled = false;

bool sabotageLights = false;
bool sabotageDoors = false;
bool reactorMeltdown = false;
bool impostorWin = false;
bool crewmatesWin = false;

int meltdownTimer = MELTDOWN_START_FRAMES;
int ventCooldown = 0;

// --------------------------------------------------
// HELPERS
// --------------------------------------------------
bool near(int x1, int y1, int x2, int y2, int d = 12) {
  return (abs(x1 - x2) <= d && abs(y1 - y2) <= d);
}

int findNearestVent(int row, int col, int px, int py) {
  int best = -1;
  int bestDist = 9999;

  for (int i = 0; i < NUM_VENTS; i++) {
    if (vents[i].row == row && vents[i].col == col) {
      int dx = px - vents[i].x;
      int dy = py - vents[i].y;
      int dist = abs(dx) + abs(dy);
      if (dist < bestDist) {
        bestDist = dist;
        best = i;
      }
    }
  }
  return best;
}

// --------------------------------------------------
// GAME RESET
// --------------------------------------------------
void initGame() {
  playerX = 40;
  playerY = 30;
  roomRow = 1;
  roomCol = 1;

  inVent = false;
  meetingCalled = false;
  sabotageLights = false;
  sabotageDoors = false;
  reactorMeltdown = false;
  impostorWin = false;
  crewmatesWin = false;

  meltdownTimer = MELTDOWN_START_FRAMES;
  ventCooldown = 0;

  for (int i = 0; i < NUM_CREWMATES; i++) {
    crewmates[i].x = random(10, ROOM_W - 10);
    crewmates[i].y = random(10, ROOM_H - 10);
    crewmates[i].alive = true;
    crewmates[i].roomRow = 1;
    crewmates[i].roomCol = 1;
    crewmates[i].targetRow = random(0, MAP_ROWS);
    crewmates[i].targetCol = random(0, MAP_COLS);
    crewmates[i].suspicion = 0;
    crewmates[i].tolerance = random(20, 80);
    crewmates[i].gotBodySuspicion = false;
  }
}

// --------------------------------------------------
// CREWMATE BODY REPORTS + SUSPICION
// --------------------------------------------------
void checkBodyReports() {
  if (meetingCalled || impostorWin || crewmatesWin) return;

  bool someoneDead = false;
  for (int i = 0; i < NUM_CREWMATES; i++)
    if (!crewmates[i].alive) someoneDead = true;

  if (!someoneDead) return;

  for (int i = 0; i < NUM_CREWMATES; i++) {
    if (!crewmates[i].alive) continue;

    for (int j = 0; j < NUM_CREWMATES; j++) {
      if (i == j) continue;

      if (!crewmates[j].alive &&
          crewmates[j].roomRow == crewmates[i].roomRow &&
          crewmates[j].roomCol == crewmates[i].roomCol &&
          near(crewmates[i].x, crewmates[i].y, crewmates[j].x, crewmates[j].y, 20)) {

        crewmates[i].suspicion -= 5;
        if (crewmates[i].suspicion < 0) crewmates[i].suspicion = 0;

        meetingCalled = true;
        return;
      }
    }
  }
}

// --------------------------------------------------
// CREWMATE UPDATE
// --------------------------------------------------
void updateCrewmates() {
  if (meetingCalled || impostorWin || crewmatesWin) return;

  for (int i = 0; i < NUM_CREWMATES; i++) {
    if (!crewmates[i].alive) continue;

    Crewmate &c = crewmates[i];

    // S‑ONCE: +10 suspicion ONCE when entering room with dead body
    bool bodyInRoom = false;
    for (int j = 0; j < NUM_CREWMATES; j++) {
      if (!crewmates[j].alive &&
          crewmates[j].roomRow == c.roomRow &&
          crewmates[j].roomCol == c.roomCol) {
        bodyInRoom = true;
      }
    }
    if (bodyInRoom && !c.gotBodySuspicion) {
      c.suspicion += 10;
      c.gotBodySuspicion = true;
    }
    if (!bodyInRoom) {
      c.gotBodySuspicion = false;
    }

    // suspicion > tolerance → force meeting
    if (c.suspicion > c.tolerance) {
      meetingCalled = true;
      return;
    }

    // movement
    if (c.roomRow == c.targetRow && c.roomCol == c.targetCol) {
      c.targetRow = random(0, MAP_ROWS);
      c.targetCol = random(0, MAP_COLS);
    }

    int speed = 1;

    if (c.roomRow != c.targetRow || c.roomCol != c.targetCol) {
      int doorX = ROOM_W / 2;
      int doorY = ROOM_H / 2;

      if (c.targetRow < c.roomRow) {
        doorY = 0;
        if (c.y > doorY) c.y -= speed;
        if (abs(c.y - doorY) <= 1 && !sabotageDoors) {
          c.roomRow--;
          c.y = ROOM_H - 10;
        }
      } else if (c.targetRow > c.roomRow) {
        doorY = ROOM_H - 8;
        if (c.y < doorY) c.y += speed;
        if (abs(c.y - doorY) <= 1 && !sabotageDoors) {
          c.roomRow++;
          c.y = 2;
        }
      } else if (c.targetCol < c.roomCol) {
        doorX = 0;
        if (c.x > doorX) c.x -= speed;
        if (abs(c.x - doorX) <= 1 && !sabotageDoors) {
          c.roomCol--;
          c.x = ROOM_W - 10;
        }
      } else if (c.targetCol > c.roomCol) {
        doorX = ROOM_W - 8;
        if (c.x < doorX) c.x += speed;
        if (abs(c.x - doorX) <= 1 && !sabotageDoors) {
          c.roomCol++;
          c.x = 2;
        }
      }
    }
  }
}

// --------------------------------------------------
// CREWMATES FIX MELTDOWN
// --------------------------------------------------
void crewmatesFixMeltdown() {
  if (!reactorMeltdown) return;

  for (int i = 0; i < NUM_CREWMATES; i++) {
    if (!crewmates[i].alive) continue;

    if (crewmates[i].roomRow == 1 && crewmates[i].roomCol == 0) {
      if (random(0, 100) < 75) {
        reactorMeltdown = false;
        meltdownTimer = MELTDOWN_START_FRAMES;
        return;
      }
    }
  }
}

// --------------------------------------------------
// MOVEMENT
// --------------------------------------------------
void handleMovement() {
  if (meetingCalled || impostorWin || crewmatesWin) return;

  if (!inVent) {
    int speed = 1;

    if (arduboy.pressed(LEFT_BUTTON))  playerX -= speed;
    if (arduboy.pressed(RIGHT_BUTTON)) playerX += speed;
    if (arduboy.pressed(UP_BUTTON))    playerY -= speed;
    if (arduboy.pressed(DOWN_BUTTON))  playerY += speed;
  }

  if (playerX < 0) playerX = 0;
  if (playerX > ROOM_W - 8) playerX = ROOM_W - 8;
  if (playerY < 0) playerY = 0;
  if (playerY > ROOM_H - 8) playerY = ROOM_H - 8;

  int doorX1 = ROOM_W/2 - 8;
  int doorX2 = ROOM_W/2 + 8;
  int doorY1 = ROOM_H/2 - 8;
  int doorY2 = ROOM_H/2 + 8;

  if (!sabotageDoors && !inVent) {
    if (playerY <= 0 &&
        playerX >= doorX1 && playerX <= doorX2 &&
        roomRow > 0)
    {
      roomRow--;
      playerY = ROOM_H - 10;
    }

    if (playerY >= ROOM_H - 8 &&
        playerX >= doorX1 && playerX <= doorX2 &&
        roomRow < MAP_ROWS - 1)
    {
      roomRow++;
      playerY = 2;
    }

    if (playerX <= 0 &&
        playerY >= doorY1 && playerY <= doorY2 &&
        roomCol > 0)
    {
      roomCol--;
      playerX = ROOM_W - 10;
    }

    if (playerX >= ROOM_W - 8 &&
        playerY >= doorY1 && playerY <= doorY2 &&
        roomCol < MAP_COLS - 1)
    {
      roomCol++;
      playerX = 2;
    }
  }
}

// --------------------------------------------------
// ACTIONS
// --------------------------------------------------
void handleActions() { 
    if (impostorWin || crewmatesWin) return; 

    // Emergency meeting (DOWN + B) 
    if (!meetingCalled && arduboy.pressed(DOWN_BUTTON) && arduboy.justPressed(B_BUTTON)) { 
        bool someoneDead = false; 
        for (int i = 0; i < NUM_CREWMATES; i++) {
            if (!crewmates[i].alive) someoneDead = true; 
        }
        if (someoneDead) { 
            meetingCalled = true; 
            // –5 suspicion for all crewmates 
            for (int k = 0; k < NUM_CREWMATES; k++) { 
                crewmates[k].suspicion -= 5; 
                if (crewmates[k].suspicion < 0) crewmates[k].suspicion = 0; 
            } 
        } 
    } 

    if (meetingCalled) return; 

    // Kill (B) 
    if (!inVent && arduboy.justPressed(B_BUTTON)) { 
        for (int i = 0; i < NUM_CREWMATES; i++) { 
            if (crewmates[i].alive && crewmates[i].roomRow == roomRow && crewmates[i].roomCol == roomCol && near(playerX, playerY, crewmates[i].x, crewmates[i].y)) { 
                crewmates[i].alive = false; 
                // witnesses +20 suspicion 
                for (int w = 0; w < NUM_CREWMATES; w++) { 
                    if (crewmates[w].alive && crewmates[w].roomRow == roomRow && crewmates[w].roomCol == roomCol) { 
                        crewmates[w].suspicion += 20; 
                    } 
                } 
                return; 
            } 
        } 
    } 

    // Vent (A) 
    if (arduboy.justPressed(A_BUTTON) && ventCooldown == 0) { 
        int v = findNearestVent(roomRow, roomCol, playerX, playerY);
        
        if (!inVent) { 
            // Check if a vent exists in this room and the player is near it before entering
            if (v != -1 && near(playerX, playerY, vents[v].x, vents[v].y)) { 
                inVent = true; 
                playerX = vents[v].x; 
                playerY = vents[v].y; 
                ventCooldown = VENT_COOLDOWN_FRAMES; 
                return; 
            } 
        } else { 
            // When exiting, transport player to the linked vent destination
            if (v != -1) { 
                int destVent = vents[v].linkA; // Or your custom transit layout logic
                roomRow = vents[destVent].row; 
                roomCol = vents[destVent].col; 
                playerX = vents[destVent].x; 
                playerY = vents[destVent].y; 
                inVent = false; 
                ventCooldown = VENT_COOLDOWN_FRAMES; 
                return; 
            } 
        } 
    } 

    // Sabotage (UP + A) 
    if (!inVent && arduboy.pressed(UP_BUTTON) && arduboy.justPressed(A_BUTTON)) { 
        // Activate sabotage states explicitly instead of inversion toggles
        sabotageLights = true; 
        sabotageDoors = true; 
        if (!reactorMeltdown) {
            reactorMeltdown = true; 
            meltdownTimer = MELTDOWN_START_FRAMES; 
        }
    } 
}

// --------------------------------------------------
// MELTDOWN TIMER
// --------------------------------------------------
void updateMeltdown() {
  if (reactorMeltdown && !meetingCalled && !impostorWin && !crewmatesWin) {
    if (meltdownTimer > 0) meltdownTimer--;
    else impostorWin = true;
  }
}

// --------------------------------------------------
// MEETING RESOLUTION (V1 voting)
// --------------------------------------------------
void resolveMeeting() {
  if (!meetingCalled) return;

  int votesOnPlayer = 0;
  int votesOnCrew[NUM_CREWMATES];
  for (int i = 0; i < NUM_CREWMATES; i++) votesOnCrew[i] = 0;

  for (int i = 0; i < NUM_CREWMATES; i++) {
    if (!crewmates[i].alive) continue;

    Crewmate &c = crewmates[i];

    int voteTarget = -1; // -1 skip, -2 player, 0..N-1 crewmate

    if (c.suspicion > c.tolerance) {
      // high suspicion → vote player
      voteTarget = -2;
    } else if (c.suspicion > c.tolerance / 2) {
      // medium suspicion → vote random crewmate
      int idx = random(0, NUM_CREWMATES);
      while (!crewmates[idx].alive || idx == i) {
        idx = random(0, NUM_CREWMATES);
      }
      voteTarget = idx;
    } else {
      // low suspicion → skip
      voteTarget = -1;
    }

    if (voteTarget == -2) votesOnPlayer++;
    else if (voteTarget >= 0) votesOnCrew[voteTarget]++;
  }

  int aliveCount = 0;
  for (int i = 0; i < NUM_CREWMATES; i++)
    if (crewmates[i].alive) aliveCount++;

  int majority = (aliveCount / 2) + 1;

  // eject player
  if (votesOnPlayer >= majority) {
    crewmatesWin = true;
    meetingCalled = false;
    return;
  }

  // eject crewmate
  // eject crewmate
  int bestCrew = -1;
  int bestVotes = 0;
  for (int i = 0; i < NUM_CREWMATES; i++) {
    if (votesOnCrew[i] > bestVotes) {
      bestVotes = votesOnCrew[i];
      bestCrew = i;
    }
  }

  if (bestCrew != -1 && bestVotes >= majority) {
    crewmates[bestCrew].alive = false;
  }

  meetingCalled = false;
}

// --------------------------------------------------
// DRAW ROOM
// --------------------------------------------------
void drawRoom() {
  arduboy.drawBitmap(0, 0, worldMap[roomRow][roomCol], ROOM_W, ROOM_H, WHITE);

  int cx = ROOM_W / 2;
  int cy = ROOM_H / 2;

  arduboy.drawRect(cx - 8, 0,        16, 8, BLACK);
  arduboy.drawRect(cx - 8, ROOM_H-8, 16, 8, BLACK);
  arduboy.drawRect(0,      cy - 8,    8, 16, BLACK);
  arduboy.drawRect(ROOM_W-8, cy - 8,  8, 16, BLACK);

  if (sabotageDoors) {
    arduboy.fillRect(cx - 8, 0,        16, 8, BLACK);
    arduboy.fillRect(cx - 8, ROOM_H-8, 16, 8, BLACK);
    arduboy.fillRect(0,      cy - 8,    8, 16, BLACK);
    arduboy.fillRect(ROOM_W-8, cy - 8,  8, 16, BLACK);
  }
}

// --------------------------------------------------
// DRAW ENTITIES
// --------------------------------------------------
void drawEntities() {

  if (meetingCalled) {
    arduboy.fillRect(0, 0, ROOM_W, ROOM_H, BLACK);
    arduboy.setCursor(10, 20);
    arduboy.print(F("EMERGENCY MEETING"));
    arduboy.setCursor(10, 35);
    arduboy.print(F("Voting..."));
    return;
  }

  // crewmates (alive)
  for (int i = 0; i < NUM_CREWMATES; i++) {
    if (crewmates[i].alive &&
        crewmates[i].roomRow == roomRow &&
        crewmates[i].roomCol == roomCol) {

      arduboy.fillRect(crewmates[i].x, crewmates[i].y, 4, 4, BLACK);
    }
  }

  // dead bodies (white X)
  for (int i = 0; i < NUM_CREWMATES; i++) {
    if (!crewmates[i].alive &&
        crewmates[i].roomRow == roomRow &&
        crewmates[i].roomCol == roomCol) {

      int bx = crewmates[i].x;
      int by = crewmates[i].y;
      arduboy.drawLine(bx,     by,     bx+4, by+4, WHITE);
      arduboy.drawLine(bx+4,   by,     bx,   by+4, WHITE);
    }
  }

  // vents
  for (int i = 0; i < NUM_VENTS; i++) {
    if (vents[i].row == roomRow && vents[i].col == roomCol) {

      int vx = vents[i].x;
      int vy = vents[i].y;

      arduboy.fillRect(vx, vy, 14, 14, WHITE);
      arduboy.drawRect(vx, vy, 14, 14, BLACK);

      arduboy.drawLine(vx + 2, vy + 4,  vx + 12, vy + 4,  BLACK);
      arduboy.drawLine(vx + 2, vy + 7,  vx + 12, vy + 7,  BLACK);
      arduboy.drawLine(vx + 2, vy + 10, vx + 12, vy + 10, BLACK);
    }
  }

  if (sabotageLights) {
    arduboy.fillRect(0, 0, ROOM_W, ROOM_H, BLACK);
  }

  if (!inVent && !impostorWin && !crewmatesWin) {
    arduboy.fillRect(playerX, playerY, 8, 8, BLACK);
  }

  if (ventCooldown > 0) {
    int w = map(ventCooldown, 0, VENT_COOLDOWN_FRAMES, 0, ROOM_W);
    arduboy.drawRect(0, ROOM_H - 4, ROOM_W, 4, WHITE);
    arduboy.fillRect(0, ROOM_H - 4, w, 4, WHITE);
  }

  if (reactorMeltdown && !impostorWin && !crewmatesWin) {
    arduboy.setCursor(2, 2);
    arduboy.print(F("REACTOR MELTDOWN"));
    arduboy.setCursor(2, 12);
    arduboy.print(F("TIME: "));
    arduboy.print(meltdownTimer / 30);
  }

  if (impostorWin) {
    arduboy.fillRect(0, 0, ROOM_W, ROOM_H, BLACK);
    arduboy.setCursor(20, 20);
    arduboy.print(F("IMPOSTOR WINS"));
    arduboy.setCursor(10, 35);
    arduboy.print(F("Press A to restart"));
  }

  if (crewmatesWin) {
    arduboy.fillRect(0, 0, ROOM_W, ROOM_H, BLACK);
    arduboy.setCursor(20, 20);
    arduboy.print(F("CREWMATES WIN"));
    arduboy.setCursor(10, 35);
    arduboy.print(F("Press A to restart"));
  }
}

// --------------------------------------------------
// SETUP / LOOP
// --------------------------------------------------
void setup() {
  arduboy.begin();
  arduboy.setFrameRate(30);
  randomSeed(arduboy.cpuLoad());
  initGame();
}

void loop() {
  if (!arduboy.nextFrame()) return;

  arduboy.pollButtons();

  // restart after win
  if ((impostorWin || crewmatesWin) && arduboy.justPressed(A_BUTTON)) {
    initGame();
  }

  handleMovement();
  handleActions();
  updateCrewmates();
  checkBodyReports();
  updateMeltdown();
  crewmatesFixMeltdown();

  if (ventCooldown > 0) ventCooldown--;

  if (meetingCalled) {
    resolveMeeting();
  }

  arduboy.clear();
  drawRoom();
  drawEntities();
  arduboy.display();
}
